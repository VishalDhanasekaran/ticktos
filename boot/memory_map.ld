MEMORY
{
    BOOTROM (RX) : ORIGIN = 0x00000000, LENGTH = 0x00000400
    APPROM  (RX) : ORIGIN = 0x00000400, LENGTH = 0x0003C000
    RAM     (rwx): ORIGIN = 0x20000000, LENGTH = 0x00008000
}

__BOOTROM_START__ = ORIGIN(BOOTROM);
__BOOTROM_SIZE__  = LENGTH(BOOTROM);
__APPROM_START__  = ORIGIN(APPROM);
__APPROM_SIZE__   = LENGTH(APPROM);
